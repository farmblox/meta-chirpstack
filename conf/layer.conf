## conf/layer.conf
```bitbake
BBPATH .= ":${LAYERDIR}"

# Save layerdir for use in functions outside .conf scope
LAYERDIR_CHIRPSTACK_CORE := "${LAYERDIR}"

# We have recipes-* directories, add to BBFILES
BBFILES += "${LAYERDIR}/recipes-*/*/*.bb \
	${LAYERDIR}/recipes-*/*/*.bbappend"

BBFILE_COLLECTIONS += "chirpstack_core"
BBFILE_PATTERN_chirpstack_core = "^${LAYERDIR}/"
BBFILE_PRIORITY_chirpstack_core = "6"

LAYERSERIES_COMPAT_chirpstack_core = "dunfell honister"
```
